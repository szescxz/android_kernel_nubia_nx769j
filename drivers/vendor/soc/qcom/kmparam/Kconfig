## drivers/vendor/soc/qcom/kmparam/Kconfig
```kconfig
# SPDX-License-Identifier: GPL-2.0-only
config VENDOR_KERNEL_MODULE_PARAM
	tristate "parse kernel module param and export to other vendor module"
	depends on ARCH_QCOM
	help
	  parse kernel module param and export to other vendor module
```

## drivers/vendor/soc/qcom/pmlog/Kconfig
```kconfig
#
# pmlog driver
#
config VENDOR_PMLOG
  tristate "PMLOG Driver"
  default n
  help
    This program is used for recode the ap and modem's sleep and wake time

config VENDOR_PMLOG_PLATFORM
    int "PMLog Platform"
    default 98
    help
      control each platform's subsystems name and number
```

## drivers/vendor/soc/qcom/rchip/Kconfig
```kconfig
# SPDX-License-Identifier: GPL-2.0-only
#
# Misc strange devices
#

config ZTE_RCHIP
	tristate "zte driver for rchip control"
	help
	  rchip driver for beidou message.


config ZTE_RCHIP_V2
	tristate "zte driver version 2 for rchip control"
	help
	  rchip driver version 2 for beidou message.
```

## drivers/vendor/soc/qcom/stats_info/Kconfig
```kconfig
config VENDOR_STATS_INFO
	tristate "ZTE STATS INFO"
	default n
	help
	  Say 'y' here to include support for zte imem info.
```

## drivers/vendor/soc/qcom/tiantong/Kconfig
```kconfig
# SPDX-License-Identifier: GPL-2.0-only
#
# tiantong devices
#

config ZTE_TIANTONG
	tristate "zte driver for tiantong control"
	help
	  driver for the powerup/poweroff/reset of tiantong chip
```
