## drivers/input/hall/Kconfig
```kconfig
config SENSORS_HALL_AH1898
	tristate "HALL sensor for ah1898"
	default n
	help
	  This driver provides support for the AH1898 HALL sensor
	  The sensor report a gpio interrupt for input system. The sensor is for
	  /sys/bus/platform/ah1898.
```

## drivers/nfc/st54j/Kconfig
```kconfig
config NFC_ST54J
	tristate "ST NCI based NFC Driver for ST54J"
	depends on I2C && SPI
	help
	  This enables the NFC driver for ST54J based devices.
	  This is for i2c connected with NFC controller and spi connected
	  with eSE.NCI protocol logic resides in the usermode and it has
	  no other NFC dependencies.

config NFC_ST54J_ESE
	tristate "ST NCI based NFC ESE Driver for ST54J"
	depends on I2C && SPI
	help
	  This enables the NFC ESE driver for ST54J based devices.
	  This is for i2c connected with NFC controller and spi connected
	  with eSE.NCI protocol logic resides in the usermode and it has
	  no other NFC dependencies.

config NFC_GPIO35_CLKREQ
	tristate "ST NCI based NFC ESE Driver for ST54L"
	depends on I2C && SPI
	help
	  This enables the NFC ESE driver for ST54J based devices.
	  This is for i2c connected with NFC controller and spi connected
	  with eSE.NCI protocol logic resides in the usermode and it has
	  no other NFC dependencies.
```

## drivers/nubia/sensors_sensitivity/Kconfig
```kconfig
config NUBIA_SENSORS_SENS_EN
	tristate "support sensor sensitivity adjust, such as acceleration, gyrocopter etc."
	default n
	help
		support sensor sensitivity adjust, such as acceleration, gyrocopter etc. 
```

## drivers/vendor/common/Kconfig
```kconfig
config VENDOR_COMMON_COMPILE
	bool "drivers/vendor/common drivers compile control"
	default n
	help
	  This enables drivers/vendor/common drivers to be compiled.

config VENDOR_SOC_QCOM_COMPILE
	bool "drivers/vendor/soc/qcom drivers compile control"
	default n
	help
	  This enables drivers/vendor/soc/qcom drivers to be compiled.

config VENDOR_SOC_MTK_COMPILE
	bool "drivers/vendor/soc/mediatek drivers compile control"
	default n
	help
	  This enables drivers/vendor/soc/mediatek drivers to be compiled.

config VENDOR_SOC_SPRD_COMPILE
	bool "drivers/vendor/soc/sprd drivers compile control"
	default n
	help
	  This enables drivers/vendor/soc/sprd drivers to be compiled.

config SOC_QCOM
	bool "qcom common drivers"
	default n
	help
	  This enables support for common driver in qcom platform.

config SOC_MTK
	bool "MTK common drivers"
	default n
	help
	  This enables support for common driver in MTK platform.

config SOC_SPRD
	bool "spred common drivers"
	default n
	help
	  This enables support for common driver in sprd platform.

config NUBIA_KEYBOARD_GPIOKEYS
    tristate "nubia_gpio_keys"
    depends on KEYBOARD_GPIO
    default n
    help
        This enables nubia_gpio_keys

source "drivers/vendor/common/power/Kconfig"
source "drivers/vendor/common/tfa98xx/Kconfig"
source "drivers/vendor/common/aw882xx/Kconfig"
source "drivers/vendor/common/zcard_det/Kconfig"
source "drivers/vendor/common/zlog/Kconfig"
source "drivers/vendor/common/touchscreen_v2/Kconfig"
source "drivers/vendor/common/fan/Kconfig"
source "drivers/vendor/common/aw96205/Kconfig"
source "drivers/vendor/common/nubia_hw_version/Kconfig"
source "drivers/vendor/common/sensor/Kconfig"
```

## drivers/vendor/common/aw882xx/Kconfig
```kconfig
config SND_SMARTPA_AW882XX
  bool "SoC Audio for awinic aw882xxseries"

config SND_SOC_AW882XX_TDM
  bool "SoC Audio for awinic aw882xxseries tdm"
```

## drivers/vendor/common/aw96205/Kconfig
```kconfig
#
# Mediatek AW9620X Driver
#

config AW9620X_SAR
	tristate "Awinic AW9620X_Sar driver"
	depends on I2C
	help
	  Say Y here if you have Awinic AW9620X_Sar controller
	  chip in your system.
	  If unsure, say N.
	  To compile this driver as a module, choose M here: the
	  module will be called  AW9620X_Sar key.
```

## drivers/vendor/common/fan/Kconfig
```kconfig
#
# Fan driver configuration
#
config SOC_FAN
        tristate "Soc Fan"
        default n
       help
          Say Y here if you use soc control fan.

#config FAN_UPDATA
#	bool "Fan updata"
#	default n
```

## drivers/vendor/common/nubia_hw_version/Kconfig
```kconfig
################nubia hw_version config start################
config NUBIA_HW_VERSION
	tristate "NUBIA HW VERSION"
	default n
	help
	  NUBIA HW VERSION

config NUBIA_HW_VERSION_DEBUG
	bool "NUBIA HW VERSION DEBUG"
	depends on NUBIA_HW_VERSION
	default n
	help
		NUBIA HW VERSION DEBUG

config NUBIA_HW_VER_BY_ADC
	bool "NUBIA HW VER BY ADC"
	depends on NUBIA_HW_VERSION
	default n
	help
		NUBIA HW VER BY ADC

config NUBIA_HW_CONFIG_BY_GPIO
	bool "NUBIA HW CONFIG BY GPIO"
	depends on NUBIA_HW_VERSION
	default n
	help
		NUBIA HW CONFIG BY GPIO

config NUBIA_HW_GPIO_BY_PM
	bool "NUBIA_HW_GPIO_BY_PM"
	depends on NUBIA_HW_VERSION
	default n
	help
		NUBIA HW GPIO BY PM

config NUBIA_HW_CPU_SERIAL_NUM
	bool "NUBIA HW CPU SERIAL NUM"
	depends on NUBIA_HW_VERSION
	default n
	help
	  NUBIA HW CPU SERIAL NUM

config NUBIA_PRODUCT_NX709J
        tristate "NUBIA PRODUCT BUILD"
        depends on NUBIA_HW_VERSION
        default n
        help
          NUBIA PRODUCT BUILD
```

## drivers/vendor/common/power/Kconfig
```kconfig
config POWER_VENDOR_COMMON
	tristate "zte power common"
	help
	  Say Y here, if supported zte power common

source "drivers/vendor/common/power/charger_policy/Kconfig"
source "drivers/vendor/common/power/misc/Kconfig"
source "drivers/vendor/common/power/zte_supply/Kconfig"
```

## drivers/vendor/common/power/charger_policy/Kconfig
```kconfig
config VENDOR_BATTERY_CAPACITY_LEARNING
	tristate "Battery Capacity Learning driver"
	depends on POWER_VENDOR_COMMON
	default n
	help
	  Say Y here to enable the "Battery Capacity Learning" driver

config VENDOR_CHARGE_ARBITRATE_SERVICE
	tristate "Charge Arbitrate Service Driver"
	depends on POWER_VENDOR_COMMON
	default n
	help
	  Say Y here to enable the "Charge Arbitrate Service" driver

config VENDOR_CHARGER_POLICY_SERVICE
	tristate "Charger Policy Service Driver"
	depends on POWER_VENDOR_COMMON && VENDOR_ZTE_MISC
	default n
	help
	  Say Y here to enable the "Charger Policy Service" driver
```

## drivers/vendor/common/power/misc/Kconfig
```kconfig
config VENDOR_ZTE_MISC
	tristate "zte misc driver"
	depends on POWER_VENDOR_COMMON
	help
	  Say Y here, if supported zte misc
```

## drivers/vendor/common/power/zte_supply/Kconfig
```kconfig
# SPDX-License-Identifier: GPL-2.0-only
menuconfig ZTE_POWER_SUPPLY
	tristate "ZTE Power supply class support"
	depends on POWER_VENDOR_COMMON
	help
	  Say Y here to enable power supply class support. This allows
	  power supply (batteries, AC, USB) monitoring by userspace
	  via sysfs and uevent (if available) and/or APM kernel interface
	  (if selected below).
if ZTE_POWER_SUPPLY
config ZTE_POWER_SUPPLY_DEBUG
	bool "ZTE Power supply debug"
 	default n
	help
	  Say Y here to enable debugging messages for power supply class
	  and drivers.
config ZTE_POWER_SUPPLY_COMMON
	bool "ZTE Power supply common"
 	default n
	help
	  Say Y here to enable power supply class.
config ZTE_POWER_SUPPLY_HWMON
	bool
	prompt "ZTE Expose power supply sensors as hwmon device"
	depends on HWMON=y || HWMON=POWER_SUPPLY
	default y
	help
	  This options enables API that allows sensors found on a
	  power supply device (current, voltage, temperature) to be
	  exposed as a hwmon device.
	  Say Y here if you want power supplies to
	  have hwmon sysfs interface too.
endif # ZTE_POWER_SUPPLY
```

## drivers/vendor/common/sensor/Kconfig
```kconfig
config CUSTOM_KERNEL_HALL_3AXIS_SENSOR
	bool "ZTE_HALL_3AXIS SENSOR"
		depends on I2C
		default n
		help
		  Say Y here if you have zte hall-3axis sensor.
		  If unsure, say N.

source "drivers/vendor/common/sensor/hall-3axis/Kconfig"
```

## drivers/vendor/common/sensor/hall-3axis/Kconfig
```kconfig
config HALL_3AXIS_SENSOR_AK09973
	tristate "HALL_3AXIS_SENSOR_AK09973"
		depends on I2C
		default n
		help
		  Say Y here if you have ak09973 hall 3axis sensor.
		  If unsure, say N.
```

## drivers/vendor/common/tfa98xx/Kconfig
```kconfig
config SND_SOC_TFA98XX
  bool "Support Goodix smartpa driver"

config SND_SOC_TFA98XX_SINGLE
  bool "Support Goodix smartpa driver"

config SND_SOC_TFA98XX_DOUBLE
  bool "Support Goodix double smartpa driver"
```

## drivers/vendor/common/touchscreen_v2/Kconfig
```kconfig
source "drivers/vendor/common/touchscreen_v2/focaltech_touch_3681/Kconfig"
source "drivers/vendor/common/touchscreen_v2/goodix_berlin_driver_v2/Kconfig"
source "drivers/vendor/common/touchscreen_v2/goodix_berlin_driver_9916r/Kconfig"
source "drivers/vendor/common/touchscreen_v2/goodix_berlin_driver_9966/Kconfig"

config TOUCHSCREEN_BOARD_NAME
	string "config board firmware folder"

config TOUCHSCREEN_DRM_PANEL_NOTIFIER
	bool "add qcom drm panel support"
	default n
	help
	  Say Y here to enable debug tools.

	  If unsure, say N.

config TOUCHSCREEN_UFP_MAC
	bool "tp under fingerprint status machine"
	default n
	help
	  Say Y here if you want to have a under fingerprint status machine
	  If unsure, say N.

config TOUCHSCREEN_POINT_REPORT_CHECK
	bool "all point clean when tp irq timeout"
	default n
	help
	  Say Y here to enable .
	  If unsure, say N.
config TOUCHSCREEN_POINT_SIMULAT_UF
 	bool "tp under fingerprint status machine"
 	default n
 	help
 	  Say Y here if you want to simulate finger down
 	  If unsure, say N.

config TOUCHSCREEN_BOARD_NAME
	string "config board firmware folder"

config TOUCHSCREEN_9916R_REPORT_RATE
	bool "tp report rate when use 9916r"
	default n
	help
	  Say Y here if you want to use PQ82A11 report rate
	  If unsure, say N.

config TOUCHSCREEN_IOVDD_GPIO_POWER
	bool "tp iovdd power on use gpio"
	default n
	help
	  Say Y here if you want to use iovdd gpio power on
	  If unsure, say N.

config TOUCHSCREEN_FOLD_PROJECT
	bool "tp use fold project"
	default n
	help
	  Say Y here if you want to use FOLD
	  If unsure, say N.

config TOUCHSCREEN_PQ82A02_ZTE_SR
	bool "tp make ZTE_GOODIX_SR is 1 when in recovery"
	default n
	help
	  Say Y here if you want to use recovery
	  If unsure, say N.
```

## drivers/vendor/common/touchscreen_v2/goodix_berlin_driver_9966/Kconfig
```kconfig
#
# Goodix touchscreen driver configuration
#
menuconfig TOUCHSCREEN_GOODIX_BRL_9966
	tristate "Goodix berlin touchscreen"
	help
	  Say Y here if you have a Goodix berlin series touch controller
	  to your system.
	  If build module, say M.
	  If unsure, say N.

if TOUCHSCREEN_GOODIX_BRL_9966

config TOUCHSCREEN_GOODIX_BRL_I2C
	bool "support I2C bus connection"
	depends on I2C
	default n
	help
	  Say Y here if the touchscreen is connected via I2C bus.

config TOUCHSCREEN_GOODIX_BRL_SPI
	bool "support SPI bus connection"
	help
		Say Y here if the touchscreen is connected via SPI bus.

endif
```

## drivers/vendor/common/touchscreen_v2/goodix_berlin_driver_v2/Kconfig
```kconfig
#
# Goodix touchscreen driver configuration
#
menuconfig TOUCHSCREEN_GOODIX_BRL_V2
	bool "Goodix berlin touchscreen"
	default n
	help
	  Say Y here if you have a Goodix berlin series touch controller
	  to your system.

	  If build module, say M.
	  If unsure, say N.

if TOUCHSCREEN_GOODIX_BRL_V2

config TOUCHSCREEN_GOODIX_BRL_I2C
	bool "support I2C bus connection"
	depends on I2C
	default n
	help
	  Say Y here if the touchscreen is connected via I2C bus.

config TOUCHSCREEN_GOODIX_BRL_SPI
	bool "support SPI bus connection"
	default n
	help
		Say Y here if the touchscreen is connected via SPI bus.

endif
```

## drivers/vendor/common/zcard_det/Kconfig
```kconfig
# SPDX-License-Identifier: GPL-2.0-only
#
# Misc strange devices
#

config ZCARD_HOLDER
	tristate "zte card holder test Support"
	help
	  support zte card holder test.
```

## drivers/vendor/common/zlog/Kconfig
```kconfig
config VENDOR_ZTE_DEV_MONITOR_SYSTEM
	bool "ZTE DEVICE MONITOR SYSTEM"
	default n
	help
	  Say Y here, if supported zte log device monitor system

source "drivers/vendor/common/zlog/zlog_exception/Kconfig"
source "drivers/vendor/common/zlog/zlog_common/Kconfig"
source "drivers/vendor/common/zlog/zlog_test/Kconfig"
```

## drivers/vendor/common/zlog/zlog_common/Kconfig
```kconfig
config VENDOR_ZTE_LOG_COMMON
	tristate "ZTE LOG COMMON"
	depends on VENDOR_ZTE_LOG_EXCEPTION
	default n
	help
	  Say Y here, if supported zte log common
```

## drivers/vendor/common/zlog/zlog_exception/Kconfig
```kconfig
config VENDOR_ZTE_LOG_EXCEPTION
	tristate "ZTE LOG EXCEPTION"
	default n
	help
	  Say Y here, if supported zte log exception
```

## drivers/vendor/common/zlog/zlog_test/Kconfig
```kconfig
config VENDOR_ZTE_LOG_E_TEST
	tristate "ZTE LOG EXCEPTION TEST"
	depends on VENDOR_ZTE_LOG_EXCEPTION
	depends on VENDOR_ZTE_LOG_COMMON
	default n
	help
	  Say Y here, if supported zte log exception
```

## drivers/vendor/soc/qcom/Kconfig
```kconfig
config VENDOR_SOC_QCOM_SRC
	bool "drivers/vendor/soc/qcom drivers compile control"
	default n
	help
		This enables drivers/vendor/soc/qcom drivers to be compiled.

source "drivers/vendor/soc/qcom/imem_info/Kconfig"
source "drivers/vendor/soc/qcom/kmparam/Kconfig"
source "drivers/vendor/soc/qcom/pmlog/Kconfig"
source "drivers/vendor/soc/qcom/stats_info/Kconfig"
source "drivers/vendor/soc/qcom/rchip/Kconfig"
source "drivers/vendor/soc/qcom/tiantong/Kconfig"
```

## drivers/vendor/soc/qcom/imem_info/Kconfig
```kconfig
config VENDOR_IMEM_INFO
	tristate "ZTE IMEM INFO"
	default n
	help
	  Say 'y' here to include support for zte imem info.

config NUBIA_BOARD_ID
	bool "nubia board id"
	default n
	help
		This enabled for nubia hw board id
```
